# file: embedded-journey.ioc
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Mcu.Family=STM32F4
Mcu.Name=STM32F446R(C-E)Tx
Mcu.Package=LQFP64
NVIC.PriorityGroup=NVIC_PRIORITYGROUP_4
ProjectManager.HeapSize=0x200
ProjectManager.StackSize=0x400
ProjectManager.TargetToolchain=STM32CubeIDE
RCC.CortexFreq_Value=16000000
RCC.USBFreq_Value=96000000
RCC.VCOOutputFreq_Value=192000000
board=custom

// file: Core/Src/main.c
/* USER CODE BEGIN Header */
/**
  ******************************************************************************
  * @file           : main.c
  * @brief          : Main program body
  ******************************************************************************
  * @attention
  *
  * Copyright (c) 2026 STMicroelectronics.
  * All rights reserved.
  *
  * This software is licensed under terms that can be found in the LICENSE file
  * in the root directory of this software component.
  * If no LICENSE file comes with this software, it is provided AS-IS.
  *
  ******************************************************************************
  */
/* USER CODE END Header */
#include "main.h"
/* USER CODE BEGIN Includes */
#include <string.h>
#include "usart2.h"
/* USER CODE END Includes */

/* USER CODE BEGIN PD */
#define LED_PIN          5U     /* LD2 on PA5 */
#define BLINK_PERIOD_MS  250U
#define CMD_MAX_LEN      16
/* USER CODE END PD */

void SystemClock_Config(void);

int main(void)
{

  /* MCU Configuration--------------------------------------------------------*/

  /* Reset of all peripherals, Initializes the Flash interface and the Systick. */
  HAL_Init();

  /* Configure the system clock */
  SystemClock_Config();

  /* Initialize all configured peripherals */
  /* USER CODE BEGIN 2 */
  /* Full access to the FPU (coprocessors CP10 and CP11) */
  SCB->CPACR |= (3UL << (10U * 2U)) | (3UL << (11U * 2U));

  USART2_init();   /* clocks, PA2/PA3 alternate function, baud rate, TX + RX */

  /* PA5 (LD2) as a push-pull output */
  RCC->AHB1ENR |= RCC_AHB1ENR_GPIOAEN;
  GPIOA->MODER &= ~GPIO_MODER_MODER5;
  GPIOA->MODER |=  GPIO_MODER_MODER5_0;

  USART2_printCharacter(':');
  USART2_printCharacter(')');
  USART2_print("\r\nHello!\r\n");
  printUSART("I am your new STM32F%dRE!\r\n", 446);

  char cmd[CMD_MAX_LEN];
  int blink_mode = 0;
  /* USER CODE END 2 */

  /* Infinite loop */
  /* USER CODE BEGIN WHILE */
  while (1)
  {
      if (!blink_mode)
      {
          printUSART("\r\nPlease enter your choice (On / Off / Blink):\r\n");
          USART2_readString(cmd, CMD_MAX_LEN);

          if (strcmp(cmd, "On") == 0) {
              GPIOA->BSRR = (1U << LED_PIN);            /* atomic set */
              printUSART("LED is ON\r\n");
          }
          else if (strcmp(cmd, "Off") == 0) {
              GPIOA->BSRR = (1U << (LED_PIN + 16U));    /* atomic reset */
              printUSART("LED is OFF\r\n");
          }
          else if (strcmp(cmd, "Blink") == 0) {
              blink_mode = 1;
              printUSART("Entering Blink Mode! (Press any key to stop)\r\n");
          }
          else {
              printUSART("Unknown command: %s\r\n", cmd);
          }
      }
      else
      {
          GPIOA->ODR ^= (1U << LED_PIN);
          HAL_Delay(BLINK_PERIOD_MS);

          if (USART2->SR & USART_SR_RXNE) {
              (void)USART2->DR;   /* discard the key that stopped blinking */
              blink_mode = 0;
              printUSART("Blink Mode Stopped.\r\n");
          }
      }
    /* USER CODE END WHILE */

  }
}

void SystemClock_Config(void)
{
  RCC_OscInitTypeDef RCC_OscInitStruct = {0};
  RCC_ClkInitTypeDef RCC_ClkInitStruct = {0};

  /** Configure the main internal regulator output voltage
  */
  __HAL_RCC_PWR_CLK_ENABLE();
  __HAL_PWR_VOLTAGESCALING_CONFIG(PWR_REGULATOR_VOLTAGE_SCALE3);

  /** Initializes the RCC Oscillators according to the specified parameters
  * in the RCC_OscInitTypeDef structure.
  */
  RCC_OscInitStruct.OscillatorType = RCC_OSCILLATORTYPE_HSI;
  RCC_OscInitStruct.HSIState = RCC_HSI_ON;
  RCC_OscInitStruct.HSICalibrationValue = RCC_HSICALIBRATION_DEFAULT;
  RCC_OscInitStruct.PLL.PLLState = RCC_PLL_NONE;
  if (HAL_RCC_OscConfig(&RCC_OscInitStruct) != HAL_OK)
  {
    Error_Handler();
  }

  /** Initializes the CPU, AHB and APB buses clocks
  */
  RCC_ClkInitStruct.ClockType = RCC_CLOCKTYPE_HCLK|RCC_CLOCKTYPE_SYSCLK
                              |RCC_CLOCKTYPE_PCLK1|RCC_CLOCKTYPE_PCLK2;
  RCC_ClkInitStruct.SYSCLKSource = RCC_SYSCLKSOURCE_HSI;
  RCC_ClkInitStruct.AHBCLKDivider = RCC_SYSCLK_DIV1;
  RCC_ClkInitStruct.APB1CLKDivider = RCC_HCLK_DIV1;
  RCC_ClkInitStruct.APB2CLKDivider = RCC_HCLK_DIV1;

  if (HAL_RCC_ClockConfig(&RCC_ClkInitStruct, FLASH_LATENCY_0) != HAL_OK)
  {
    Error_Handler();
  }
}

void Error_Handler(void)
{
  __disable_irq();
  while (1)
  {
  }
}
